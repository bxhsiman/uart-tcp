## sdkconfig.defaults
```kconfig
# ESP-IDF Configuration Defaults for HTTP Server
# 这些配置是解决HTTP 431错误的关键设置

# HTTP服务器核心配置 - 解决431错误的关键
CONFIG_HTTPD_MAX_REQ_HDR_LEN=4096
CONFIG_HTTPD_MAX_URI_LEN=2048
CONFIG_HTTPD_PURGE_BUF_LEN=256

# 增大lwIP TCP缓冲区
CONFIG_LWIP_TCP_MSS=1460
CONFIG_LWIP_TCP_SND_BUF_DEFAULT=8192
CONFIG_LWIP_TCP_RCV_WND_DEFAULT=8192
CONFIG_LWIP_TCP_RECVMBOX_SIZE=64

# 增大系统任务栈
CONFIG_ESP_MAIN_TASK_STACK_SIZE=8192
CONFIG_ESP_SYSTEM_EVENT_TASK_STACK_SIZE=4096

# 内存优化
CONFIG_ESP_TASK_WDT_TIMEOUT_S=10
CONFIG_FREERTOS_HZ=1000
```
